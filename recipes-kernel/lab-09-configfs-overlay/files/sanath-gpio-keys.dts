/dts-v1/;
/plugin/;
/ {
    fragment@0 {
        target-path = "/";
        __overlay__ {
            gpio_keys_node: gpio-keys {
                compatible = "gpio-keys";
                #address-cells = <1>;
                #size-cells = <0>;
                button@0 {
                    reg = <0>;
                    label = "Sanath Button";
                    gpios = <&gpio 23 1>;
                    linux,code = <28>;
                    debounce-interval = <50>;
                };
            };
        };
    };
};
