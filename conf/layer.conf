## conf/layer.conf
```bitbake
# We have a conf and classes directory, add to BBPATH
BBPATH .= ":${LAYERDIR}"

# We have recipes-* directories, add to BBFILES
BBFILES += "${LAYERDIR}/recipes-*/*/*.bb \
            ${LAYERDIR}/recipes-*/*/*.bbappend"

BBFILE_COLLECTIONS += "meta-sanath"
BBFILE_PATTERN_meta-sanath = "^${LAYERDIR}/"
BBFILE_PRIORITY_meta-sanath = "6"

LAYERDEPENDS_meta-sanath = "core"
LAYERSERIES_COMPAT_meta-sanath = "kirkstone"
```
